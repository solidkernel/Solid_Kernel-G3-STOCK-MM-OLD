## block/Kconfig.iosched
```kconfig
if BLOCK

menu "IO Schedulers"

config IOSCHED_FIOPS
	tristate "IOPS based I/O scheduler"
	default y
	---help---
	  This is an IOPS based I/O scheduler. It will try to distribute
	  IOPS equally among all processes in the system. It's mainly for
	  Flash based storage.

choice
	prompt "Default I/O scheduler"
	default DEFAULT_FIOPS
	help
	  Select the I/O scheduler which will be used by default for all
	  block devices.

	config DEFAULT_FIOPS
		bool "FIOPS" if IOSCHED_FIOPS=y

endchoice

config DEFAULT_IOSCHED
	string
	default "fiops" if DEFAULT_FIOPS

endmenu

endif
```
